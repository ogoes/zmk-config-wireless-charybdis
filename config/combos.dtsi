#include "keycodes.h" 
// indebted and with much reference to dxmh's zmk-config

compatible = "zmk,combos";
#define LONG_TIMEOUT_MS 100
#define NORMAL_LAYERS 0 1 2 3 4 5
#define LOCK_LAYER 6

#define COMBO(NAME, BINDINGS, KEYPOS) \
  combo_##NAME { \
    bindings = <BINDINGS>; \
    key-positions = <KEYPOS>; \
    layers = <NORMAL_LAYERS>; \
  };

#define COMBO_LONG(NAME, BINDINGS, KEYPOS) \
  combo_##NAME { \
    bindings = <BINDINGS>; \
    key-positions = <KEYPOS>; \
    layers = <NORMAL_LAYERS>; \
    timeout-ms = <LONG_TIMEOUT_MS>; \
  };


/*           35 Keys
╭──────────────╮ ╭──────────────╮
│ 0  1  2  3  4│ │ 5  6  7  8  9│
│10 11 12 13 14│ │15 16 17 18 19│
│20 21 22 23 24│ │25 26 27 28 29│
╰─────╮30 31 32│ │33 34╭────────╯
      ╰────────╯ ╰─────╯         */


COMBO(esc, &kp ESC, 0 1)
COMBO(tab, &kp TAB, 1 2)

COMBO(copy, &kp LC(C), 21 22)
COMBO(paste, &kp LC(V), 22 23)
COMBO(cut, &kp LC(X), 20 21)

COMBO(backspace, &kp BSPC, 27 28)
COMBO(cmd, &sk LCMD, 30 31)
COMBO(opt, &sk LALT, 32 33)

//COMBO_LONG(capsword, &caps_word, 14 15)
